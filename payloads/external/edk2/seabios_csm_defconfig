## src/drivers/nvidia/optimus/Kconfig
```kconfig
config DRIVERS_NVIDIA_OPTIMUS
	bool
	default n

config NVIDIA_OPTIMUS
	bool "Enable Nvidia Optimus"
	depends on DRIVERS_NVIDIA_OPTIMUS
	depends on HAVE_ACPI_TABLES
	help
	  Add ACPI code to support power switching the dGPU at runtime.

config DRIVERS_NVIDIA_OPTIMUS_GC6
	bool
	depends on DRIVERS_NVIDIA_OPTIMUS
	default n

config NVIDIA_OPTIMUS_GC6
	bool "Enable Nvidia Optimus GC6"
	depends on DRIVERS_NVIDIA_OPTIMUS_GC6 && NVIDIA_OPTIMUS
	depends on HAVE_ACPI_TABLES
	help
	  Add ACPI code to support the GC6 dGPU state.
```

## src/mainboard/clevo/tgl-h/Kconfig
```kconfig
## SPDX-License-Identifier: GPL-2.0-only

config BOARD_CLEVO_TGLH_COMMON
	def_bool n
	select BOARD_ROMSIZE_KB_16384
	select DRIVERS_I2C_HID
	select DRIVERS_NVIDIA_OPTIMUS
	select DRIVERS_NVIDIA_OPTIMUS_GC6
	select DRIVERS_USB_ACPI
	# TODO: Review and improve this driver
	select EC_CLEVO_IT5570E
	select HAVE_ACPI_RESUME
	select HAVE_ACPI_TABLES
	select HAVE_CMOS_DEFAULT
	select HAVE_OPTION_TABLE
	select INTEL_GMA_HAVE_VBT
	select INTEL_LPSS_UART_FOR_CONSOLE
	select MAINBOARD_HAS_TPM2
	select MAINBOARD_USES_IFD_GBE_REGION
	select MEMORY_MAPPED_TPM
	select NO_UART_ON_SUPERIO
	select SOC_INTEL_COMMON_BLOCK_HDA_VERB
	select SOC_INTEL_TIGERLAKE
	select SOC_INTEL_TIGERLAKE_PCH_H
	select SPD_READ_BY_WORD
	select SYSTEM_TYPE_LAPTOP
	select TPM_RDRESP_NEED_DELAY

config BOARD_CLEVO_NH5XHPQ
	select BOARD_CLEVO_TGLH_COMMON

if BOARD_CLEVO_TGLH_COMMON

config MAINBOARD_DIR
	default "clevo/tgl-h"

config VARIANT_DIR
	default "nh5xhpq" if BOARD_CLEVO_NH5XHPQ

config DEVICETREE
	default "variants/\$(CONFIG_VARIANT_DIR)/devicetree.cb"

config MAINBOARD_PART_NUMBER
	default "NH5xHPQ/NH7xHPQ" if BOARD_CLEVO_NH5XHPQ

config CBFS_SIZE
	default 0xB00000

config CONSOLE_SERIAL
	default n

config DIMM_MAX
	default 2

config DIMM_SPD_SIZE
	default 512

config MAX_CPUS
	default 16

config ONBOARD_VGA_IS_PRIMARY
	default y

config POST_DEVICE
	default n

config POST_IO
	default n

config UART_FOR_CONSOLE
	default 2

endif
```

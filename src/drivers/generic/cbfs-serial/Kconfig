## src/drivers/generic/cbfs-serial/Kconfig
```kconfig
config DRIVERS_GENERIC_CBFS_SERIAL
	bool "Serial number in CBFS"
	default n
	help
	  Enable this option to read the board serial number or
	  system UUID from a text file located in CBFS. The text
	  file should be named serial_number or system_uuid
	  respectively and include only the serial number or
	  UUID (with dashes) with no newline characters.
```

## src/mainboard/acer/Kconfig
```kconfig
## SPDX-License-Identifier: GPL-2.0-only

if VENDOR_ACER

choice
	prompt "Mainboard model"

source "src/mainboard/acer/*/Kconfig.name"

endchoice

source "src/mainboard/acer/*/Kconfig"

config MAINBOARD_VENDOR
	default "Acer"

endif # VENDOR_ACER
```

## src/mainboard/acer/aspire_vn7_572g/Kconfig
```kconfig
## SPDX-License-Identifier: GPL-2.0-or-later

if BOARD_ACER_VN7_572G

config BOARD_SPECIFIC_OPTIONS
	def_bool y
	select BOARD_ROMSIZE_KB_8192
	select DRIVERS_I2C_HID
	select DRIVERS_NVIDIA_OPTIMUS
	select EC_ACPI
	select HAVE_ACPI_RESUME
	select HAVE_ACPI_TABLES
	select HAVE_CMOS_DEFAULT
	select HAVE_INTEL_PTT
	select HAVE_OPTION_TABLE
	select INTEL_GMA_HAVE_VBT
	select INTEL_INT15
	select INTEL_LPSS_UART_FOR_CONSOLE
	select MAINBOARD_HAS_CRB_TPM
	select MAINBOARD_HAS_LIBGFXINIT
	select MAINBOARD_HAS_TPM2
	select NO_UART_ON_SUPERIO
	select ONBOARD_VGA_IS_PRIMARY
	select SOC_INTEL_COMMON_BLOCK_HDA_VERB
	select SOC_INTEL_SKYLAKE
	select SPD_READ_BY_WORD
	select SYSTEM_TYPE_LAPTOP

config MAINBOARD_DIR
	default "acer/aspire_vn7_572g"

config MAINBOARD_FAMILY
	default "Aspire V Nitro"

config MAINBOARD_PART_NUMBER
	default "Aspire VN7-572G"

config CBFS_SIZE
	default 0x600000

config CONSOLE_SERIAL
	default n

config UART_FOR_CONSOLE
	default 2

config POST_DEVICE
	default n

config POST_IO
	default n

config MAX_CPUS
	default 4

config ME_CLEANER_ARGS
	default "-s"

config DIMM_MAX
	default 2

config DIMM_SPD_SIZE
	default 512

config VGA_BIOS_ID
	default "8086,1916"

config VGA_BIOS_DGPU_ID
	default "10de,139a"

config PXE_ROM_ID
	string
	default "10ec,8168"

config LINEAR_FRAMEBUFFER_MAX_WIDTH
	default 1920

config LINEAR_FRAMEBUFFER_MAX_HEIGHT
	default 1080

config INCLUDE_NHLT_BLOBS
	bool "Include blobs for audio"
	select NHLT_DMIC_1CH

endif
```
